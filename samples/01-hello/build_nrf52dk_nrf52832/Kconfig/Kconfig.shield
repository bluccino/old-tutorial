## samples/01-hello/build_nrf52dk_nrf52832/Kconfig/Kconfig.shield
```kconfig
osource "/opt/nordic/ncs/v1.6.1/nrf/boards/shields/*/Kconfig.shield"
osource "/opt/nordic/ncs/v1.6.1/zephyr/boards/shields/*/Kconfig.shield"
```

## samples/01-hello/build_nrf52dk_nrf52832/Kconfig/Kconfig.shield.defconfig
```kconfig
osource "/opt/nordic/ncs/v1.6.1/nrf/boards/shields/*/Kconfig.defconfig"
osource "/opt/nordic/ncs/v1.6.1/zephyr/boards/shields/*/Kconfig.defconfig"
```

## samples/01-hello/build_nrf52dk_nrf52832/Kconfig/Kconfig.soc.arch
```kconfig
osource "/opt/nordic/ncs/v1.6.1/zephyr/soc/$(ARCH)/Kconfig"
osource "/opt/nordic/ncs/v1.6.1/zephyr/soc/$(ARCH)/*/Kconfig"
```
